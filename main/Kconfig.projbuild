## main/Kconfig.projbuild
```kconfig
menu "Free Ice Cream"

    config LOCALE_NUMBER
        int "local include file number"
        default 0
        help
            locale number (0 includes "locale0.h")

endmenu
```
